## rs232_can/main/Kconfig.projbuild
```kconfig
menu "Example Configuration"

    config RX_pin
        string "GPIO RX pin"
        default "4"
        help
            Enter pin to be used as RX


    config TX_pin
        string "GPIO TX pin"
        default "5"
        help
            Enter pin to be used as RX

    config baud
        string "Enter BAUDRATE to be used"
        default "115200"
        help
            Enter BaudRate

endmenu
```

## testsockserv/main/Kconfig.projbuild
```kconfig
menu "Example Configuration"

    config WIFI_SSID
        string "WiFi SSID"
        default "myssid"
        help
            SSID (network name) for the example to connect to.

    config WIFI_PASSWORD
        string "WiFi Password"
        default "mypassword"
        help
            WiFi password (WPA or WPA2) for the example to use.
            Can be left blank if the network has no security set.

    config PORT
        int "Port"
        range 0 65535
        default 9998
        help
            Local port the example server will listen on.

    config DAC_PIN
        int "Pin"
        default 1
        help 
            1 : 25
            2 : 26

endmenu
```
